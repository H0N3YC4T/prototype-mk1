## app/dts/bindings/behaviors/zmk,behavior-cycle-animation.yaml
```yaml
# SPDX-License-Identifier: MIT


description: ZMK behavior to control Nice!View animation and theme

compatible: "zmk,behavior-cycle-animation"

include: one_param.yaml
```

## boards/shields/nice_view_gem/Kconfig.defconfig
```kconfig
if SHIELD_NICE_VIEW_GEM

config LV_Z_VDB_SIZE
    default 100

config LV_DPI_DEF
    default 161

config LV_Z_BITS_PER_PIXEL
    default 1

choice LV_COLOR_DEPTH
    default LV_COLOR_DEPTH_1
endchoice

choice ZMK_DISPLAY_WORK_QUEUE
    default ZMK_DISPLAY_WORK_QUEUE_DEDICATED
endchoice

choice ZMK_DISPLAY_STATUS_SCREEN
    default ZMK_DISPLAY_STATUS_SCREEN_CUSTOM
endchoice

config LV_Z_MEM_POOL_SIZE
    default 8192 if ZMK_DISPLAY_STATUS_SCREEN_CUSTOM

config ZMK_DISPLAY_STATUS_SCREEN_CUSTOM
    imply NICE_VIEW_WIDGET_STATUS

config NICE_VIEW_GEM_WPM_FIXED_RANGE
    bool "Enable fixed range for WPM gauge/chart"
    default y

config NICE_VIEW_GEM_WPM_FIXED_RANGE_MAX
    int "Fixed range maximum for WPM gauge/chart"
    default 100

# --- Peripheral gem artwork. Theme switching is PAUSED (full multi-theme system
# --- is backed up on branch dev/periph-theme): the halves show a single static
# --- random transmutation frame to save battery. default n = static (no loop).
config NICE_VIEW_ANIMATION
    bool "Animate the peripheral artwork (vs. a single static frame)"
    default n

# Compile ONLY the transmutation theme's bitmaps (drops the other five to save
# peripheral flash) and lock the gem to it. default y = transmutation-only. Set
# to n (+ NICE_VIEW_ANIMATION=y) to restore the full multi-theme switching system.
# Pairs with the matching lock in animation.c, gated on this same symbol.
config NICE_VIEW_GEM_TRANSMUTATION_ONLY
    bool "Compile only the transmutation theme (slim the peripheral build)"
    default y

choice NICE_VIEW_ANIMATION_THEME
    prompt "Default peripheral animation theme"
    default NICE_VIEW_ANIMATION_THEME_TRANSMUTATION
config NICE_VIEW_ANIMATION_THEME_CRYSTAL
    bool "Crystal"
config NICE_VIEW_ANIMATION_THEME_LANDSCAPE
    bool "Landscape (dunes / pyramids / mountains)"
config NICE_VIEW_ANIMATION_THEME_EVANGELION
    bool "Evangelion (spaceships / eva units)"
config NICE_VIEW_ANIMATION_THEME_TRANSMUTATION
    bool "Transmutation"
config NICE_VIEW_ANIMATION_THEME_OMNISSIAH
    bool "Omnissiah"
config NICE_VIEW_ANIMATION_THEME_ULTRAMAR
    bool "Ultramar"
endchoice

config NICE_VIEW_WIDGET_STATUS
    select LV_USE_LABEL
    select LV_USE_IMAGE
    select LV_USE_CANVAS
    select LV_USE_ANIMIMG
    select LV_USE_ANIMATION

config NICE_VIEW_WIDGET_INVERTED
    bool "Invert display colors"

if !ZMK_SPLIT || ZMK_SPLIT_ROLE_CENTRAL

config NICE_VIEW_WIDGET_STATUS
    select ZMK_WPM

endif # !ZMK_SPLIT || ZMK_SPLIT_ROLE_CENTRAL

endif # SHIELD_NICE_VIEW_GEM
```

## boards/shields/prototype_mk1/Kconfig.defconfig
```kconfig
# Copyright (c) 2020 Ryan Cross
# SPDX-License-Identifier: MIT


if SHIELD_PROTOTYPE_MK1_CLEFT || SHIELD_PROTOTYPE_MK1_DONGLE
config ZMK_KEYBOARD_NAME
    default "Prototype_Mk1"
config ZMK_SPLIT_ROLE_CENTRAL
    default y
endif 

if SHIELD_PROTOTYPE_MK1_DONGLE
config BT_MAX_CONN
    default 5
config BT_MAX_PAIRED
    default 5
config ZMK_SPLIT_BLE_CENTRAL_PERIPHERALS
    default 2
endif # SHIELD_PROTOTYPE_MK1_DONGLE

# XIAO/prospector receiver dongle. Central role + split BLE central. Display and
# LVGL config come entirely from the prospector_adapter shield, so this shield is
# deliberately NOT part of the nice!view-mono LVGL defconfig block below.
if SHIELD_PROTOTYPE_MK1_WAVESHARE
config ZMK_KEYBOARD_NAME
    default "Prototype_Mk1"
config ZMK_SPLIT_ROLE_CENTRAL
    default y
config ZMK_SPLIT
    default y
config BT_MAX_CONN
    default 5
config BT_MAX_PAIRED
    default 5
config ZMK_SPLIT_BLE_CENTRAL_PERIPHERALS
    default 2
endif # SHIELD_PROTOTYPE_MK1_WAVESHARE

if SHIELD_PROTOTYPE_MK1_CLEFT
config BT_MAX_CONN
    default 4
config BT_MAX_PAIRED
    default 4
endif # SHIELD_PROTOTYPE_MK1_CLEFT

if SHIELD_PROTOTYPE_MK1_CLEFT || SHIELD_PROTOTYPE_MK1_PLEFT || SHIELD_PROTOTYPE_MK1_PRIGHT || SHIELD_PROTOTYPE_MK1_DONGLE
config ZMK_SPLIT
    default y
if LVGL


config LV_Z_VDB_SIZE
    default 64

if SHIELD_PROTOTYPE_MK1_DONGLE || SHIELD_PROTOTYPE_MK1_CLEFT
choice ZMK_DISPLAY_WORK_QUEUE
    default ZMK_DISPLAY_WORK_QUEUE_DEDICATED
endchoice
endif

config LV_DPI_DEF
    default 148

config LV_Z_BITS_PER_PIXEL
    default 1

choice LV_COLOR_DEPTH
    default LV_COLOR_DEPTH_1
endchoice

endif # LVGL


if ZMK_BACKLIGHT
config PWM
    default y
config LED_PWM
    default y
endif

endif
```

## boards/shields/prototype_mk1/Kconfig.shield
```kconfig
# Copyright (c) 2020 Ryan Cross
# SPDX-License-Identifier: MIT

config SHIELD_PROTOTYPE_MK1_PLEFT
    def_bool $(shields_list_contains,prototype_mk1_periph_left)

config SHIELD_PROTOTYPE_MK1_PRIGHT
    def_bool $(shields_list_contains,prototype_mk1_periph_right)

config SHIELD_PROTOTYPE_MK1_DONGLE
    def_bool $(shields_list_contains,prototype_mk1_dongle)

config SHIELD_PROTOTYPE_MK1_WAVESHARE
    def_bool $(shields_list_contains,prototype_mk1_waveshare)

config SHIELD_PROTOTYPE_MK1_CLEFT
    def_bool $(shields_list_contains,prototype_mk1_central_left)
```

## config/west.yml
```yaml
manifest:
  remotes:
    - name: zmkfirmware
      url-base: https://github.com/zmkfirmware
    - name: englmaxi
      url-base: https://github.com/englmaxi
    - name: honeycat
      url-base: https://github.com/H0N3YC4T
  projects:
    - name: zmk-dongle-display
      remote: englmaxi
      revision: 2bb333f87136d33e94a49d86236ed9ec254a8060
    - name: zmk
      remote: honeycat
      revision: 0cb08f0c82dc20c3e068c17557b3cbcb12379ad5
      import: app/west.yml
    - name: dongle-mk1
      remote: honeycat
      revision: main
    - name: nice-view-mk1
      remote: honeycat
      revision: main
  self:
    path: config
```
