## config/west.yml
```yaml
manifest:
  remotes:
    - name: zmkfirmware
      url-base: https://github.com/zmkfirmware
    - name: englmaxi
      url-base: https://github.com/englmaxi
    - name: honeycat
      url-base: https://github.com/H0N3YC4T
  projects:
    - name: zmk-dongle-display
      remote: englmaxi
      revision: 2bb333f87136d33e94a49d86236ed9ec254a8060
    - name: zmk
      remote: honeycat
      revision: 377027bb3681e715f192955e6c5b0ccbb459ff8e
      import: app/west.yml
    - name: dongle-mk1
      remote: honeycat
      revision: main
    - name: nice-view-mk1
      remote: honeycat
      revision: main
  self:
    path: config
```
