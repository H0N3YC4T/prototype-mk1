/*
 * Copyright (c) 2020 Ryan Cross
 *
 * SPDX-License-Identifier: MIT
 *
 * nice!view receiver dongle (nice!nano v2 + nice_view_adapter + nice_view_mk1).
 * Shared dongle DT comes from prototype_mk1_dongle_base.dtsi; this overlay adds
 * the dongle encoders. The display + chosen node come from the nice_view_mk1
 * shield, same as the halves.
 */

#include "prototype_mk1_dongle_base.dtsi"

/ {
    left_encoder: encoder_left {
        compatible = "alps,ec11";
        a-gpios = <&gpio0 22 (GPIO_ACTIVE_HIGH | GPIO_PULL_UP)>;
        b-gpios = <&gpio0 29 (GPIO_ACTIVE_HIGH | GPIO_PULL_UP)>;
        steps = <80>;
        status = "okay";
    };

    right_encoder: encoder_right {
        compatible = "alps,ec11";
        a-gpios = <&gpio0 29 (GPIO_ACTIVE_HIGH | GPIO_PULL_UP)>;
        b-gpios = <&gpio0 22 (GPIO_ACTIVE_HIGH | GPIO_PULL_UP)>;
        steps = <80>;
        status = "okay";
    };

    sensors: sensors {
        compatible = "zmk,keymap-sensors";
        sensors = <&left_encoder &right_encoder>;
        triggers-per-rotation = <20>;
    };
};
