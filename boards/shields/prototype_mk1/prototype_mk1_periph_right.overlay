/*
 * Copyright (c) 2020 Ryan Cross
 *
 * SPDX-License-Identifier: MIT
 */

#include "prototype_mk1.dtsi"

&default_transform {
    col-offset = <6>;
};

&kscan0 {
    col-gpios
        = <&gpio0  2  GPIO_ACTIVE_HIGH> 
        , <&gpio1  15 GPIO_ACTIVE_HIGH> 
        , <&gpio1  13 GPIO_ACTIVE_HIGH> 
        , <&gpio1  11 GPIO_ACTIVE_HIGH> 
        , <&gpio0  10 GPIO_ACTIVE_HIGH> 
        , <&gpio0  9  GPIO_ACTIVE_HIGH> 
        ;
};


&right_encoder {
    status = "okay";
};

